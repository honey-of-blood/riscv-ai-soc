## phase22_portability/zephyr/boards/riscv/rv32_soc/Kconfig.board
```kconfig
# Kconfig.board — Zephyr board-level Kconfig for RV32 AI SoC

config BOARD_RV32_SOC
    bool "RV32 AI SoC (Artix-7 / DE1-SoC / ULX3S)"
    depends on SOC_SERIES_RISCV32
    select SOC_RV32_SOC
    help
      Board definition for the RV32 AI SoC portfolio project.
      Supports three board variants via separate DTS overlays:
        rv32_soc_arty_a7  — Digilent Arty A7-100T (Xilinx Artix-7)
        rv32_soc_de1_soc  — Terasic DE1-SoC (Intel Cyclone V)
        rv32_soc_ulx3s    — Radiona ULX3S (Lattice ECP5)
      All variants share the same peripheral memory map and use the
      same firmware binaries.

config BOARD_RV32_SOC_ARTY_A7
    bool "Arty A7-100T variant"
    depends on BOARD_RV32_SOC

config BOARD_RV32_SOC_DE1_SOC
    bool "DE1-SoC Cyclone V variant"
    depends on BOARD_RV32_SOC

config BOARD_RV32_SOC_ULX3S
    bool "ULX3S ECP5 variant"
    depends on BOARD_RV32_SOC
```

## phase22_portability/zephyr/boards/riscv/rv32_soc/rv32_soc_defconfig
```kconfig
# rv32_soc_defconfig — Zephyr default config for RV32 AI SoC
# Generated by: make BOARD=rv32_soc defconfig

CONFIG_SOC_SERIES_RISCV32=y
CONFIG_SOC_RV32_SOC=y
CONFIG_BOARD_RV32_SOC=y

# ── RISC-V ISA ───────────────────────────────────────────────────────────────
CONFIG_RISCV_ISA_RV32I=y
CONFIG_RISCV_ISA_EXT_M=y
CONFIG_RISCV_ISA_EXT_A=y
CONFIG_RISCV_ISA_EXT_C=y

# ── Clocking ─────────────────────────────────────────────────────────────────
CONFIG_SYS_CLOCK_HW_CYCLES_PER_SEC=100000000

# ── Console / UART ────────────────────────────────────────────────────────────
CONFIG_SERIAL=y
CONFIG_UART_NS16550=y
CONFIG_UART_CONSOLE=y

# ── Interrupt controller ──────────────────────────────────────────────────────
CONFIG_RISCV_HAS_PLIC=y

# ── GPIO ─────────────────────────────────────────────────────────────────────
CONFIG_GPIO=y

# ── SPI ──────────────────────────────────────────────────────────────────────
CONFIG_SPI=y

# ── I2C ──────────────────────────────────────────────────────────────────────
CONFIG_I2C=y

# ── Heap / stack ─────────────────────────────────────────────────────────────
CONFIG_HEAP_MEM_POOL_SIZE=8192
CONFIG_MAIN_STACK_SIZE=2048
CONFIG_ISR_STACK_SIZE=2048

# ── Logging ───────────────────────────────────────────────────────────────────
CONFIG_LOG=y
CONFIG_LOG_DEFAULT_LEVEL=3

# ── Shell (optional, enable for debug builds) ────────────────────────────────
# CONFIG_SHELL=y
# CONFIG_SHELL_BACKEND_SERIAL=y
```

## phase22_portability/zephyr/soc/riscv/rv32_soc/Kconfig.soc
```kconfig
# Kconfig.soc — SoC-level Kconfig for RV32 AI SoC Zephyr port

config SOC_RV32_SOC
    bool "RV32 AI SoC"
    select RISCV
    select ATOMIC_OPERATIONS_C
    select RISCV_ISA_RV32I
    select RISCV_ISA_EXT_M
    select RISCV_ISA_EXT_A
    select RISCV_ISA_EXT_C
    select RISCV_HAS_PLIC
    select RISCV_HAS_MACHINE_TIMER
    help
      SoC definition for the RV32IMAC AI SoC designed as a portfolio
      project.  Implements:
        - 5-stage in-order pipeline with full forwarding
        - M-extension (HW multiply/divide)
        - A-extension (LR/SC atomic primitives)
        - C-extension (compressed 16-bit instructions)
        - Hardware debug (DM 0.13, JTAG TAP)
        - RISC-V PMP (8 regions)
        - NS16550 UART, GPIO, SPI, I2C, Timer, CLINT, PLIC peripherals
        - AI accelerator v3 (INT4 systolic array + DMA)

if SOC_RV32_SOC

config NUM_IRQS
    default 8

config RISCV_MACHINE_TIMER_SYSTEM_CLOCK_DIVIDER
    default 0

endif # SOC_RV32_SOC
```
